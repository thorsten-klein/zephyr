## boards/bsh/ccm_m3/Kconfig
```kconfig
# Copyright 2025 NXP
# SPDX-License-Identifier: Apache-2.0

config BOARD_CCM_M3
	bool "Enable CCM_M3 board support"
	select BOARD_EARLY_INIT_HOOK
```

## boards/bsh/ccm_m3/board.yml
```yaml
board:
  name: ccm_m3
  full_name: Central Computing Module M3
  vendor: bsh
  socs:
    - name: rw610
```

## boards/nxp/fcmb63x_egm/Kconfig
```kconfig
# Copyright 2025 NXP
# SPDX-License-Identifier: Apache-2.0

config BOARD_FCMB63X_EGM
	bool "Enable FCMB63X_EGM board support"
	select BOARD_EARLY_INIT_HOOK
```

## boards/nxp/fcmb63x_egm/Kconfig.fcmb63x_egm
```kconfig
# Copyright 2024 NXP
# SPDX-License-Identifier: Apache-2.0

config BOARD_FCMB63X_EGM
	select SOC_PART_NUMBER_RW610ETA2I
```

## boards/nxp/fcmb63x_egm/board.yml
```yaml
board:
  name: fcmb63x_egm
  full_name: FCMB63X_EGM
  vendor: quectel
  socs:
    - name: rw610
      variants:
        - name: ns
```

## drivers/bshbus/Kconfig.dummy
```kconfig
# TI BSH D-Bus configuration options

# Copyright (c) 2025 Wolfgang Birkner
# SPDX-License-Identifier: Apache-2.0

menuconfig BSHBUS_DUMMY
	bool "Dummy BSH Bus Controller Support"
	default n
	select SPI
	help
	  Enable the Dummy BSH D-Bus module driver backend for BSH Bus communication.

if BSHBUS_DUMMY

config BSHBUS_DUMMY_THREAD_STACK_SIZE
	int "Stack size for the Dummy BSH D-Bus interrupt thread"
	default 4096
	help
	  Size of the stack used for the thread handling interrupts and dispatching callbacks.

config BSHBUS_DUMMY_THREAD_PRIO
	int "Priority for the Dummy BSH D-Bus interrupt thread"
	default 0
	help
	  Priority level for the thread handling interrupts and dispatching callbacks.

endif # BSHBUS_DUMMY
```

## drivers/bshbus/Kconfig.tidbus
```kconfig
# TI BSH D-Bus configuration options

# Copyright (c) 2025 Wolfgang Birkner
# SPDX-License-Identifier: Apache-2.0

menuconfig BSHBUS_TIDBUS
	bool "TI BSH Bus Controller Support"
	default n
	select SPI
	help
	  Enable the TI BSH D-Bus module driver backend for BSH Bus communication.

if BSHBUS_TIDBUS

config BSHBUS_TIDBUS_THREAD_STACK_SIZE
	int "Stack size for the TI BSH D-Bus interrupt thread"
	default 4096
	help
	  Size of the stack used for the thread handling interrupts and dispatching callbacks.

config BSHBUS_TIDBUS_THREAD_PRIO
	int "Priority for the TI BSH D-Bus interrupt thread"
	default 0
	help
	  Priority level for the thread handling interrupts and dispatching callbacks.

endif # BSHBUS_TIDBUS
```

## dts/bindings/bshbus/ti,bshbus.yaml
```yaml
# Copyright (c) 2025 Wolfgang Birkner
# SPDX-License-Identifier: Apache-2.0

description: |
  Texas Instruments BSH D-Bus-2 controller.

  Example:
    &spi0 {
      tdbus: bshbus@0 {
        compatible = "ti,bshbus";
        reg = <0>;
        spi-max-frequency = <20000000>;
        clock-frequency = <40000000>;
        irq-gpios = <&gpio0 5 (GPIO_ACTIVE_LOW | GPIO_PULL_UP)>;
        status = "okay";
      };
    };

compatible: "ti,bshbus"

include: ["spi-device.yaml"]

properties:
  clock-frequency:
    type: int
    enum:
      - 20000000
      - 40000000
    description: |
      Controller oscillator clock frequency in Hz (20MHz or 40MHz).

  irq-gpios:
    type: phandle-array
    required: true
    description: |
      GPIO connected to the nINT pin of the chip.
```

## subsys/net/l2/bshbus/Kconfig
```kconfig
# Copyright (c) 2019 Alexander Wachter
# SPDX-License-Identifier: Apache-2.0

config NET_L2_BSHBUS_RAW
	bool "BSH Bus RAW l2 layer"
	help
	  Add a BSH Bus L2 layer driver. This is the layer for SOCKET BSHBUS.
```

## subsys/net/lib/sockets/bshbus/Kconfig
```kconfig
# SPDX-License-Identifier: Apache-2.0

config NET_SOCKETS_BSHBUS
	bool "Socket BSH Data Bus support [EXPERIMENTAL]"
	select NET_BSHBUS
	select NET_L2_BSHBUS_RAW
	select NET_CONNECTION_SOCKETS
	select EXPERIMENTAL
	help
	  The SocketBSHBUS is used for internal communication in BSH household
	  appliances via BSH Data Bus.

if NET_SOCKETS_BSHBUS

choice NET_SOCKETS_BSHBUS_DBUS2_PROTO
	prompt "BSH D-Bus-2 protocol layer"
	default NET_SOCKETS_BSHBUS_DBUS2 if NET_SOCKETS_BSHBUS

config NET_SOCKETS_BSHBUS_DBUS2
	bool "D-Bus-2 protocol for SocketBSHBUS"

config NET_SOCKETS_BSHBUS_DBUS2_DUMMY
	bool "Testing protocol for SocketBSHBUS"

endchoice

config NET_SOCKETS_BSHBUS2_RECEIVERS
	int "Maximum number of simultaneous D-Bus-2 SocketBSHBUS receivers"
	default 1
	range 1 1
	depends on NET_SOCKETS_BSHBUS_DBUS2 || NET_SOCKETS_BSHBUS_DBUS2_DUMMY
	help
	  The value configures how many sockets can be registered to the
	  SocketBSHBUS interface.

endif # NET_SOCKETS_BSHBUS
```
